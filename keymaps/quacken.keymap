// Base
// Left Top Keys
#define LTK_BASE
// Left Middle Keys
#define LMK_BASE &kp ESCAPE
// Left Lower Keys
#define LLK_BASE &kp LSHIFT

// Right Top Keys
#define RTK_BASE &kp BACKSPACE
// Right Middle Keys
#define RMK_BASE &kp ENTER
// Right Lower Keys
#define RLK_BASE &kp RSHIFT


// NumLock
// Left Top Keys
#define LTK_NUMLOCK &trans
// Left Middle Keys
#define LMK_NUMLOCK &trans
// Left Lower Keys
#define LLK_NUMLOCK &trans

// Right Top Keys
#define RTK_NUMLOCK &trans
// Right Middle Keys
#define RMK_NUMLOCK &trans
// Right Lower Keys
#define RLK_NUMLOCK &trans


// Symbols
// Left Top Keys
#define LTK_SYMBOLS &trans
// Left Middle Keys
#define LMK_SYMBOLS &trans
// Left Lower Keys
#define LLK_SYMBOLS &trans

// Right Top Keys
#define RTK_SYMBOLS &trans
// Right Middle Keys
#define RMK_SYMBOLS &trans
// Right Lower Keys
#define RLK_SYMBOLS &trans


// VimNav
// Left Top Keys
#define LTK_VIMNAV &trans
// Left Middle Keys
#define LMK_VIMNAV &trans
// Left Lower Keys
#define LLK_VIMNAV &trans

// Right Top Keys
#define RTK_VIMNAV &trans
// Right Middle Keys
#define RMK_VIMNAV &trans
// Right Lower Keys
#define RLK_VIMNAV &trans


// NumNav
// Left Top Keys
#define LTK_NUMNAV &trans
// Left Middle Keys
#define LMK_NUMNAV &trans
// Left Lower Keys
#define LLK_NUMNAV &trans

// Right Top Keys
#define RTK_NUMNAV &trans
// Right Middle Keys
#define RMK_NUMNAV &trans
// Right Lower Keys
#define RLK_NUMNAV &trans


// NumRow
// Left Top Keys
#define LTK_NUMROW &trans
// Left Middle Keys
#define LMK_NUMROW &trans
// Left Lower Keys
#define LLK_NUMROW &trans

// Right Top Keys
#define RTK_NUMROW &trans
// Right Middle Keys
#define RMK_NUMROW &trans
// Right Lower Keys
#define RLK_NUMROW &trans


// Function
// Left Top Keys
#define LTK_FUNCTION &trans
// Left Middle Keys
#define LMK_FUNCTION &trans
// Left Lower Keys
#define LLK_FUNCTION &trans

// Right Top Keys
#define RTK_FUNCTION &trans
// Right Middle Keys
#define RMK_FUNCTION &trans
// Right Lower Keys
#define RLK_FUNCTION &trans


// Azerty Base
// Left Top Keys
#define LTK_AZERTY &kp TAB
// Left Middle Keys
#define LMK_AZERTY &kp ESCAPE
// Left Lower Keys
#define LLK_AZERTY &kp LSHIFT

// Right Top Keys
#define RTK_AZERTY &kp BACKSPACE
// Right Middle Keys
#define RMK_AZERTY &EZ_SL(DK_LAYER)
// Right Lower Keys
#define RLK_AZERTY &kp RSHIFT


// DeadKey
// Left Top Keys
#define LTK_DEADKEY &trans
// Left Middle Keys
#define LMK_DEADKEY &trans
// Left Lower Keys
#define LLK_DEADKEY &trans

// Right Top Keys
#define RTK_DEADKEY &trans
// Right Middle Keys
#define RMK_DEADKEY &trans
// Right Lower Keys
#define RLK_DEADKEY &kp LS(LBKT)


// HummingBird Base
// Left Top Keys
#define LTK_HB_BASE &kp Z
// Left Middle Keys
#define LMK_HB_BASE &kp Z
// Left Lower Keys
#define LLK_HB_BASE &none

// Right Top Keys
#define RTK_HB_BASE &kp FSLH
// Right Middle Keys
#define RMK_HB_BASE &kp FSLH
// Right Lower Keys
#define RLK_HB_BASE &none


// HummingBird Symbols
// Left Top Keys
#define LTK_HB_SYMBOLS &trans
// Left Middle Keys
#define LMK_HB_SYMBOLS &trans
// Left Lower Keys
#define LLK_HB_SYMBOLS &trans

// Right Top Keys
#define RTK_HB_SYMBOLS &trans
// Right Middle Keys
#define RMK_HB_SYMBOLS &trans
// Right Lower Keys
#define RLK_HB_SYMBOLS &trans


// OneDeadKey
// Left Top Keys
#define LTK_HB_ODK &trans
// Left Middle Keys
#define LMK_HB_ODK &trans
// Left Lower Keys
#define LLK_HB_ODK &trans

// Right Top Keys
#define RTK_HB_ODK &trans
// Right Middle Keys
#define RMK_HB_ODK &trans
// Right Lower Keys
#define RLK_HB_ODK &trans


// Shifted OneDeadKey
// Left Top Keys
#define LTK_HB_SODK &trans
// Left Middle Keys
#define LMK_HB_SODK &trans
// Left Lower Keys
#define LLK_HB_SODK &trans

// Right Top Keys
#define RTK_HB_SODK &trans
// Right Middle Keys
#define RMK_HB_SODK &trans
// Right Lower Keys
#define RLK_HB_SODK &trans


// Extra Symbols
// Left Top Keys
#define LTK_HB_EXTRA_SYMS &trans
// Left Middle Keys
#define LMK_HB_EXTRA_SYMS &trans
// Left Lower Keys
#define LLK_HB_EXTRA_SYMS &trans

// Right Top Keys
#define RTK_HB_EXTRA_SYMS &trans
// Right Middle Keys
#define RMK_HB_EXTRA_SYMS &trans
// Right Lower Keys
#define RLK_HB_EXTRA_SYMS &trans


// The #define’s for extra keys must come before including selenium.keymap
#include "selenium.keymap"
