## config/west.yml
```yaml
manifest:
  remotes:
    - name: zmkfirmware
      url-base: https://github.com/zmkfirmware
    - name: OneDeadKey
      url-base: https://github.com/OneDeadKey
  projects:
    - name: zmk
      remote: zmkfirmware
      revision: main
      import: app/west.yml
    - name: zmk-config-selenium
      remote: OneDeadKey
      revision: main
  self:
    path: config
```
